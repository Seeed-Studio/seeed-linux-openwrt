## sophgo/image/multi.its
```
/dts-v1/;
/ {
	description = "CV1812H Huashan";
	images {
		kernel-1 {
			data = /incbin/("${images_dir}/Image.lzma");
			type = "kernel";
			arch = "riscv";
			os = "linux";
			compression = "lzma";
			load = <0x0 0x80200000>;
			entry = <0x0 0x80200000>;
			hash-2 {
				algo = "crc32";
			};
		};
		fdt-1 {
			data = /incbin/("${images_dir}/${dts_name}");
			type = "flat_dt";
			arch = "riscv";
			compression = "none";
			hash-1 {
				algo = "sha256";
			};
		};
	};
	configurations {
		config-cv18xx-openwrt {
			kernel = "kernel-1";
			fdt = "fdt-1";
		};
	};
};
```
