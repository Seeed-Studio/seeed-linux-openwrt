## configs/rpi_cm4_defconfig
```kconfig
CONFIG_TARGET_bcm27xx=y
CONFIG_TARGET_bcm27xx_bcm2711=y
CONFIG_TARGET_bcm27xx_bcm2711_DEVICE_rpi-4=y
CONFIG_ARIA2_ASYNC_DNS=y
CONFIG_ARIA2_COOKIE=y
CONFIG_ARIA2_NOCRYPTO=y
CONFIG_ARIA2_NOSSL=y
CONFIG_ARIA2_NOXML=y
CONFIG_ARIA2_SFTP=y
CONFIG_ATH_USER_REGD=y
CONFIG_DRIVER_WEXT_SUPPORT=y
CONFIG_GNUTLS_ALPN=y
CONFIG_GNUTLS_ANON=y
CONFIG_GNUTLS_DTLS_SRTP=y
CONFIG_GNUTLS_HEARTBEAT=y
CONFIG_GNUTLS_OCSP=y
CONFIG_GNUTLS_PSK=y
CONFIG_IB=y
CONFIG_IB_STANDALONE=y
CONFIG_IMAGEOPT=y
CONFIG_JSON_OVERVIEW_IMAGE_INFO=y
CONFIG_KERNEL_NFSD_V2_ACL_SUPPORT=y
CONFIG_KERNEL_NFSD_V3_ACL_SUPPORT=y
CONFIG_KERNEL_NFS_ACL_SUPPORT=y
CONFIG_KERNEL_NFS_V3_ACL_SUPPORT=y
CONFIG_LIBCURL_COOKIES=y
CONFIG_LIBCURL_FILE=y
CONFIG_LIBCURL_FTP=y
CONFIG_LIBCURL_HTTP=y
CONFIG_LIBCURL_NO_SMB="!"
CONFIG_LIBCURL_PROXY=y
CONFIG_LIBCURL_WOLFSSL=y
CONFIG_LIBQMI_WITH_MBIM_QMUX=y
CONFIG_LIBQMI_WITH_QRTR_GLIB=y
CONFIG_LIBSODIUM_MINIMAL=y
CONFIG_LIBSSH2_OPENSSL=y
CONFIG_LUCI_LANG_ca=y
CONFIG_LUCI_LANG_cs=y
CONFIG_LUCI_LANG_de=y
CONFIG_LUCI_LANG_el=y
CONFIG_LUCI_LANG_en=y
CONFIG_LUCI_LANG_es=y
CONFIG_LUCI_LANG_fr=y
CONFIG_LUCI_LANG_he=y
CONFIG_LUCI_LANG_hu=y
CONFIG_LUCI_LANG_it=y
CONFIG_LUCI_LANG_ja=y
CONFIG_LUCI_LANG_ko=y
CONFIG_LUCI_LANG_ms=y
CONFIG_LUCI_LANG_pl=y
CONFIG_LUCI_LANG_pt=y
CONFIG_LUCI_LANG_ro=y
CONFIG_LUCI_LANG_ru=y
CONFIG_LUCI_LANG_sk=y
CONFIG_LUCI_LANG_sv=y
CONFIG_LUCI_LANG_tr=y
CONFIG_LUCI_LANG_uk=y
CONFIG_LUCI_LANG_vi=y
CONFIG_LUCI_LANG_zh_Hans=y
CONFIG_LUCI_LANG_zh_Hant=y
CONFIG_MAKE_TOOLCHAIN=y
CONFIG_MJPG_STREAMER_V4L2=y
CONFIG_MODEMMANAGER_WITH_MBIM=y
CONFIG_MODEMMANAGER_WITH_QMI=y
CONFIG_NFS_KERNEL_SERVER_V4=y
CONFIG_NODEJS_ICU_SMALL=y
CONFIG_OPENCONNECT_GNUTLS=y
CONFIG_OPENSSL_ENGINE=y
CONFIG_OPENSSL_WITH_ASM=y
CONFIG_OPENSSL_WITH_CHACHA_POLY1305=y
CONFIG_OPENSSL_WITH_CMS=y
CONFIG_OPENSSL_WITH_DEPRECATED=y
CONFIG_OPENSSL_WITH_ERROR_MESSAGES=y
CONFIG_OPENSSL_WITH_PSK=y
CONFIG_OPENSSL_WITH_SRP=y
CONFIG_OPENSSL_WITH_TLS13=y
CONFIG_OPENVPN_openssl_ENABLE_DEF_AUTH=y
CONFIG_OPENVPN_openssl_ENABLE_FRAGMENT=y
CONFIG_OPENVPN_openssl_ENABLE_LZ4=y
CONFIG_OPENVPN_openssl_ENABLE_LZO=y
CONFIG_OPENVPN_openssl_ENABLE_MULTIHOME=y
CONFIG_OPENVPN_openssl_ENABLE_PF=y
CONFIG_OPENVPN_openssl_ENABLE_PORT_SHARE=y
CONFIG_OPENVPN_openssl_ENABLE_SMALL=y
CONFIG_PACKAGE_ATH_DFS=y
CONFIG_PACKAGE_MAC80211_DEBUGFS=y
CONFIG_PACKAGE_MAC80211_MESH=y
CONFIG_PACKAGE_adguardhome=y
CONFIG_PACKAGE_alsa-lib=y
CONFIG_PACKAGE_alsa-ucm-conf=y
CONFIG_PACKAGE_alsa-utils=y
CONFIG_PACKAGE_aria2=y
CONFIG_PACKAGE_ariang=y
CONFIG_PACKAGE_ath9k-htc-firmware=y
CONFIG_PACKAGE_attr=y
CONFIG_PACKAGE_automount=y
CONFIG_PACKAGE_avahi-dbus-daemon=y
CONFIG_PACKAGE_bind-dig=y
CONFIG_PACKAGE_bind-host=y
CONFIG_PACKAGE_bind-libs=y
CONFIG_PACKAGE_blkid=y
CONFIG_PACKAGE_block-mount=y
CONFIG_PACKAGE_boost=y
CONFIG_PACKAGE_boost-date_time=y
CONFIG_PACKAGE_boost-program_options=y
CONFIG_PACKAGE_boost-system=y
CONFIG_PACKAGE_bsdtar=y
CONFIG_PACKAGE_btrfs-progs=y
CONFIG_PACKAGE_bzip2=y
CONFIG_PACKAGE_ca-certificates=y
CONFIG_PACKAGE_carl9170-firmware=y
CONFIG_PACKAGE_cgi-io=y
CONFIG_PACKAGE_chat=y
CONFIG_PACKAGE_comgt=y
CONFIG_PACKAGE_comgt-ncm=y
CONFIG_PACKAGE_confuse=y
CONFIG_PACKAGE_containerd=y
CONFIG_PACKAGE_curl=y
CONFIG_PACKAGE_dbus=y
CONFIG_PACKAGE_ddns-scripts=y
CONFIG_PACKAGE_ddns-scripts-services=y
# CONFIG_PACKAGE_dnsmasq is not set
CONFIG_PACKAGE_dnsmasq-full=y
CONFIG_PACKAGE_dnsmasq_full_auth=y
CONFIG_PACKAGE_dnsmasq_full_conntrack=y
CONFIG_PACKAGE_dnsmasq_full_dhcp=y
CONFIG_PACKAGE_dnsmasq_full_dhcpv6=y
CONFIG_PACKAGE_dnsmasq_full_dnssec=y
CONFIG_PACKAGE_dnsmasq_full_ipset=y
CONFIG_PACKAGE_dnsmasq_full_noid=y
CONFIG_PACKAGE_dnsmasq_full_tftp=y
CONFIG_PACKAGE_docker=y
CONFIG_PACKAGE_docker-compose=y
CONFIG_PACKAGE_dockerd=y
CONFIG_PACKAGE_f2fs-tools=y
CONFIG_PACKAGE_f2fsck=y
CONFIG_PACKAGE_fdisk=y
CONFIG_PACKAGE_fdk-aac=y
CONFIG_PACKAGE_forked-daapd=y
CONFIG_PACKAGE_fstrim=y
CONFIG_PACKAGE_fuse-utils=y
CONFIG_PACKAGE_glib2=y
CONFIG_PACKAGE_gpioctl-sysfs=y
CONFIG_PACKAGE_gpiod-tools=y
CONFIG_PACKAGE_gzip=y
CONFIG_PACKAGE_haproxy=y
CONFIG_PACKAGE_hd-idle=y
CONFIG_PACKAGE_htop=y
CONFIG_PACKAGE_i2c-tools=y
CONFIG_PACKAGE_ip-full=y
CONFIG_PACKAGE_iperf=y
CONFIG_PACKAGE_iperf3=y
CONFIG_PACKAGE_ipset=y
CONFIG_PACKAGE_iptables-mod-conntrack-extra=y
CONFIG_PACKAGE_iptables-mod-extra=y
CONFIG_PACKAGE_iptables-mod-ipopt=y
CONFIG_PACKAGE_iptables-mod-tproxy=y
CONFIG_PACKAGE_irqbalance=y
CONFIG_PACKAGE_jsoncpp=y
CONFIG_PACKAGE_kcptun-client=y
CONFIG_PACKAGE_kcptun-config=y
CONFIG_PACKAGE_kmod-ath=y
CONFIG_PACKAGE_kmod-ath6kl=y
CONFIG_PACKAGE_kmod-ath6kl-usb=y
CONFIG_PACKAGE_kmod-ath9k-common=y
CONFIG_PACKAGE_kmod-ath9k-htc=y
CONFIG_PACKAGE_kmod-bonding=y
CONFIG_PACKAGE_kmod-br-netfilter=y
CONFIG_PACKAGE_kmod-carl9170=y
CONFIG_PACKAGE_kmod-crypto-acompress=y
CONFIG_PACKAGE_kmod-crypto-aead=y
CONFIG_PACKAGE_kmod-crypto-arc4=y
CONFIG_PACKAGE_kmod-crypto-cbc=y
CONFIG_PACKAGE_kmod-crypto-ccm=y
CONFIG_PACKAGE_kmod-crypto-cmac=y
CONFIG_PACKAGE_kmod-crypto-crc32=y
CONFIG_PACKAGE_kmod-crypto-crc32c=y
CONFIG_PACKAGE_kmod-crypto-ctr=y
CONFIG_PACKAGE_kmod-crypto-cts=y
CONFIG_PACKAGE_kmod-crypto-des=y
CONFIG_PACKAGE_kmod-crypto-ecb=y
CONFIG_PACKAGE_kmod-crypto-gcm=y
CONFIG_PACKAGE_kmod-crypto-gf128=y
CONFIG_PACKAGE_kmod-crypto-ghash=y
CONFIG_PACKAGE_kmod-crypto-hash=y
CONFIG_PACKAGE_kmod-crypto-hmac=y
CONFIG_PACKAGE_kmod-crypto-kpp=y
CONFIG_PACKAGE_kmod-crypto-lib-chacha20=y
CONFIG_PACKAGE_kmod-crypto-lib-chacha20poly1305=y
CONFIG_PACKAGE_kmod-crypto-lib-curve25519=y
CONFIG_PACKAGE_kmod-crypto-lib-poly1305=y
CONFIG_PACKAGE_kmod-crypto-manager=y
CONFIG_PACKAGE_kmod-crypto-md4=y
CONFIG_PACKAGE_kmod-crypto-md5=y
CONFIG_PACKAGE_kmod-crypto-null=y
CONFIG_PACKAGE_kmod-crypto-pcompress=y
CONFIG_PACKAGE_kmod-crypto-rng=y
CONFIG_PACKAGE_kmod-crypto-seqiv=y
CONFIG_PACKAGE_kmod-crypto-sha1=y
CONFIG_PACKAGE_kmod-crypto-sha256=y
CONFIG_PACKAGE_kmod-crypto-sha512=y
CONFIG_PACKAGE_kmod-dax=y
CONFIG_PACKAGE_kmod-dm=y
CONFIG_PACKAGE_kmod-dma-buf=y
CONFIG_PACKAGE_kmod-dnsresolver=y
CONFIG_PACKAGE_kmod-eeprom-93cx6=y
CONFIG_PACKAGE_kmod-fs-antfs=y
CONFIG_PACKAGE_kmod-fs-btrfs=y
CONFIG_PACKAGE_kmod-fs-cifs=y
CONFIG_PACKAGE_kmod-fs-exfat=y
CONFIG_PACKAGE_kmod-fs-exportfs=y
CONFIG_PACKAGE_kmod-fs-ext4=y
CONFIG_PACKAGE_kmod-fs-f2fs=y
CONFIG_PACKAGE_kmod-fs-nfs=y
CONFIG_PACKAGE_kmod-fs-nfs-common=y
CONFIG_PACKAGE_kmod-fs-nfs-common-rpcsec=y
CONFIG_PACKAGE_kmod-fs-nfs-v3=y
CONFIG_PACKAGE_kmod-fs-nfs-v4=y
CONFIG_PACKAGE_kmod-fs-nfsd=y
CONFIG_PACKAGE_kmod-fs-ntfs3-oot=y
CONFIG_PACKAGE_kmod-fs-squashfs=y
CONFIG_PACKAGE_kmod-fuse=y
CONFIG_PACKAGE_kmod-gre=y
CONFIG_PACKAGE_kmod-hwmon-core=y
CONFIG_PACKAGE_kmod-i2c-core=y
CONFIG_PACKAGE_kmod-ifb=y
CONFIG_PACKAGE_kmod-ikconfig=y
CONFIG_PACKAGE_kmod-ipt-conntrack-extra=y
CONFIG_PACKAGE_kmod-ipt-extra=y
CONFIG_PACKAGE_kmod-ipt-ipopt=y
CONFIG_PACKAGE_kmod-ipt-ipset=y
CONFIG_PACKAGE_kmod-ipt-raw=y
CONFIG_PACKAGE_kmod-ipt-tproxy=y
CONFIG_PACKAGE_kmod-iptunnel=y
CONFIG_PACKAGE_kmod-keys-encrypted=y
CONFIG_PACKAGE_kmod-keys-trusted=y
CONFIG_PACKAGE_kmod-l2tp=y
CONFIG_PACKAGE_kmod-lan78xx=y
CONFIG_PACKAGE_kmod-lib-crc-itu-t=y
CONFIG_PACKAGE_kmod-lib-crc16=y
CONFIG_PACKAGE_kmod-lib-crc32c=y
CONFIG_PACKAGE_kmod-lib-lzo=y
CONFIG_PACKAGE_kmod-lib-raid6=y
CONFIG_PACKAGE_kmod-lib-xor=y
CONFIG_PACKAGE_kmod-lib-zlib-deflate=y
CONFIG_PACKAGE_kmod-lib-zlib-inflate=y
CONFIG_PACKAGE_kmod-lib-zstd=y
CONFIG_PACKAGE_kmod-lib80211=y
CONFIG_PACKAGE_kmod-libertas-usb=y
CONFIG_PACKAGE_kmod-libphy=y
CONFIG_PACKAGE_kmod-mac80211=y
CONFIG_PACKAGE_kmod-macvlan=y
CONFIG_PACKAGE_kmod-md-mod=y
CONFIG_PACKAGE_kmod-md-raid0=y
CONFIG_PACKAGE_kmod-md-raid1=y
CONFIG_PACKAGE_kmod-md-raid10=y
CONFIG_PACKAGE_kmod-md-raid456=y
CONFIG_PACKAGE_kmod-mii=y
CONFIG_PACKAGE_kmod-mppe=y
CONFIG_PACKAGE_kmod-mt76-connac=y
CONFIG_PACKAGE_kmod-mt76-core=y
CONFIG_PACKAGE_kmod-mt76-usb=y
CONFIG_PACKAGE_kmod-mt7601u=y
CONFIG_PACKAGE_kmod-mt7603=y
CONFIG_PACKAGE_kmod-mt7615-common=y
CONFIG_PACKAGE_kmod-mt7663-usb-sdio=y
CONFIG_PACKAGE_kmod-mt7663u=y
CONFIG_PACKAGE_kmod-mt76x0-common=y
CONFIG_PACKAGE_kmod-mt76x02-common=y
CONFIG_PACKAGE_kmod-mt76x02-usb=y
CONFIG_PACKAGE_kmod-mt76x0u=y
CONFIG_PACKAGE_kmod-mt76x2-common=y
CONFIG_PACKAGE_kmod-mt76x2u=y
CONFIG_PACKAGE_kmod-net-prism54=y
CONFIG_PACKAGE_kmod-net-rtl8192su=y
CONFIG_PACKAGE_kmod-nf-conntrack-netlink=y
CONFIG_PACKAGE_kmod-nf-ipvs=y
CONFIG_PACKAGE_kmod-nfnetlink=y
CONFIG_PACKAGE_kmod-nft-bridge=y
CONFIG_PACKAGE_kmod-nft-core=y
CONFIG_PACKAGE_kmod-nft-netdev=y
CONFIG_PACKAGE_kmod-p54-common=y
CONFIG_PACKAGE_kmod-p54-usb=y
CONFIG_PACKAGE_kmod-pppol2tp=y
CONFIG_PACKAGE_kmod-pptp=y
CONFIG_PACKAGE_kmod-random-core=y
CONFIG_PACKAGE_kmod-rsi91x=y
CONFIG_PACKAGE_kmod-rsi91x-usb=y
CONFIG_PACKAGE_kmod-rt2500-usb=y
CONFIG_PACKAGE_kmod-rt2800-lib=y
CONFIG_PACKAGE_kmod-rt2800-usb=y
CONFIG_PACKAGE_kmod-rt2x00-lib=y
CONFIG_PACKAGE_kmod-rt2x00-usb=y
CONFIG_PACKAGE_kmod-rt73-usb=y
CONFIG_PACKAGE_kmod-rtl8187=y
CONFIG_PACKAGE_kmod-rtl8192c-common=y
CONFIG_PACKAGE_kmod-rtl8192cu=y
CONFIG_PACKAGE_kmod-rtl8xxxu=y
CONFIG_PACKAGE_kmod-rtlwifi=y
CONFIG_PACKAGE_kmod-rtlwifi-usb=y
CONFIG_PACKAGE_kmod-sched-cake=y
CONFIG_PACKAGE_kmod-sched-core=y
CONFIG_PACKAGE_kmod-scsi-core=y
CONFIG_PACKAGE_kmod-sdhci=y
CONFIG_PACKAGE_kmod-tpm=y
CONFIG_PACKAGE_kmod-tun=y
CONFIG_PACKAGE_kmod-udptunnel4=y
CONFIG_PACKAGE_kmod-udptunnel6=y
CONFIG_PACKAGE_kmod-usb-acm=y
CONFIG_PACKAGE_kmod-usb-audio=y
CONFIG_PACKAGE_kmod-usb-ehci=y
CONFIG_PACKAGE_kmod-usb-gadget=y
CONFIG_PACKAGE_kmod-usb-net=y
CONFIG_PACKAGE_kmod-usb-net-asix=y
CONFIG_PACKAGE_kmod-usb-net-asix-ax88179=y
CONFIG_PACKAGE_kmod-usb-net-cdc-eem=y
CONFIG_PACKAGE_kmod-usb-net-cdc-ether=y
CONFIG_PACKAGE_kmod-usb-net-cdc-mbim=y
CONFIG_PACKAGE_kmod-usb-net-cdc-ncm=y
CONFIG_PACKAGE_kmod-usb-net-cdc-subset=y
CONFIG_PACKAGE_kmod-usb-net-dm9601-ether=y
CONFIG_PACKAGE_kmod-usb-net-hso=y
CONFIG_PACKAGE_kmod-usb-net-huawei-cdc-ncm=y
CONFIG_PACKAGE_kmod-usb-net-ipheth=y
CONFIG_PACKAGE_kmod-usb-net-kalmia=y
CONFIG_PACKAGE_kmod-usb-net-kaweth=y
CONFIG_PACKAGE_kmod-usb-net-mcs7830=y
CONFIG_PACKAGE_kmod-usb-net-pegasus=y
CONFIG_PACKAGE_kmod-usb-net-pl=y
CONFIG_PACKAGE_kmod-usb-net-qmi-wwan=y
CONFIG_PACKAGE_kmod-usb-net-rndis=y
CONFIG_PACKAGE_kmod-usb-net-rtl8150=y
CONFIG_PACKAGE_kmod-usb-net-sierrawireless=y
CONFIG_PACKAGE_kmod-usb-net-smsc95xx=y
CONFIG_PACKAGE_kmod-usb-net-sr9700=y
CONFIG_PACKAGE_kmod-usb-net2280=y
CONFIG_PACKAGE_kmod-usb-ohci=y
CONFIG_PACKAGE_kmod-usb-ohci-pci=y
CONFIG_PACKAGE_kmod-usb-printer=y
CONFIG_PACKAGE_kmod-usb-serial=y
CONFIG_PACKAGE_kmod-usb-serial-option=y
CONFIG_PACKAGE_kmod-usb-serial-wwan=y
CONFIG_PACKAGE_kmod-usb-storage=y
CONFIG_PACKAGE_kmod-usb-storage-extras=y
CONFIG_PACKAGE_kmod-usb-storage-uas=y
CONFIG_PACKAGE_kmod-usb-uhci=y
CONFIG_PACKAGE_kmod-usb-wdm=y
CONFIG_PACKAGE_kmod-usb2=y
CONFIG_PACKAGE_kmod-usb2-pci=y
CONFIG_PACKAGE_kmod-usb3=y
CONFIG_PACKAGE_kmod-veth=y
CONFIG_PACKAGE_kmod-video-core=y
CONFIG_PACKAGE_kmod-video-uvc=y
CONFIG_PACKAGE_kmod-video-videobuf2=y
CONFIG_PACKAGE_kmod-wireguard=y
CONFIG_PACKAGE_kmod-zd1211rw=y
CONFIG_PACKAGE_lame-lib=y
CONFIG_PACKAGE_libantlr3c=y
CONFIG_PACKAGE_libao=y
CONFIG_PACKAGE_libarchive=y
CONFIG_PACKAGE_libatomic=y
CONFIG_PACKAGE_libattr=y
CONFIG_PACKAGE_libavahi-client=y
CONFIG_PACKAGE_libavahi-compat-libdnssd=y
CONFIG_PACKAGE_libavahi-dbus-support=y
CONFIG_PACKAGE_libbfd=y
CONFIG_PACKAGE_libbpf=y
CONFIG_PACKAGE_libbz2=y
CONFIG_PACKAGE_libcap=y
CONFIG_PACKAGE_libcares=y
CONFIG_PACKAGE_libconfig=y
CONFIG_PACKAGE_libcurl=y
CONFIG_PACKAGE_libdaemon=y
CONFIG_PACKAGE_libdb47=y
CONFIG_PACKAGE_libdbus=y
CONFIG_PACKAGE_libdevmapper=y
CONFIG_PACKAGE_libedit=y
CONFIG_PACKAGE_libelf=y
CONFIG_PACKAGE_libertas-usb-firmware=y
CONFIG_PACKAGE_libev=y
CONFIG_PACKAGE_libevdev=y
CONFIG_PACKAGE_libevent2=y
CONFIG_PACKAGE_libevent2-core=y
CONFIG_PACKAGE_libexif=y
CONFIG_PACKAGE_libexpat=y
CONFIG_PACKAGE_libfdisk=y
CONFIG_PACKAGE_libffi=y
CONFIG_PACKAGE_libffmpeg-full=y
CONFIG_PACKAGE_libflac=y
CONFIG_PACKAGE_libfuse=y
CONFIG_PACKAGE_libgcrypt=y
CONFIG_PACKAGE_libgdbm=y
CONFIG_PACKAGE_libgmp=y
CONFIG_PACKAGE_libgnutls=y
CONFIG_PACKAGE_libgpg-error=y
CONFIG_PACKAGE_libgpiod=y
CONFIG_PACKAGE_libi2c=y
CONFIG_PACKAGE_libiconv-full=y
CONFIG_PACKAGE_libid3tag=y
CONFIG_PACKAGE_libimobiledevice=y
CONFIG_PACKAGE_libipset=y
CONFIG_PACKAGE_libiwinfo-lua=y
CONFIG_PACKAGE_libjpeg-turbo=y
CONFIG_PACKAGE_libkeyutils=y
CONFIG_PACKAGE_libltdl=y
CONFIG_PACKAGE_liblua=y
CONFIG_PACKAGE_liblua5.3=y
CONFIG_PACKAGE_liblucihttp=y
CONFIG_PACKAGE_liblucihttp-lua=y
CONFIG_PACKAGE_liblzma=y
CONFIG_PACKAGE_liblzo=y
CONFIG_PACKAGE_libmbedtls=y
CONFIG_PACKAGE_libmbim=y
CONFIG_PACKAGE_libminiupnpc=y
CONFIG_PACKAGE_libmnl=y
CONFIG_PACKAGE_libmount=y
CONFIG_PACKAGE_libnatpmp=y
CONFIG_PACKAGE_libncurses=y
CONFIG_PACKAGE_libnetfilter-conntrack=y
CONFIG_PACKAGE_libnetsnmp=y
CONFIG_PACKAGE_libnettle=y
CONFIG_PACKAGE_libnetwork=y
CONFIG_PACKAGE_libnfnetlink=y
CONFIG_PACKAGE_libnftnl=y
CONFIG_PACKAGE_libnghttp2=y
CONFIG_PACKAGE_libogg=y
CONFIG_PACKAGE_libopenssl=y
CONFIG_PACKAGE_libopenssl-conf=y
CONFIG_PACKAGE_libpcap=y
CONFIG_PACKAGE_libpci=y
CONFIG_PACKAGE_libpcre=y
CONFIG_PACKAGE_libplist=y
CONFIG_PACKAGE_libpng=y
CONFIG_PACKAGE_libpopt=y
CONFIG_PACKAGE_libprotobuf-c=y
CONFIG_PACKAGE_libpython3=y
CONFIG_PACKAGE_libqmi=y
CONFIG_PACKAGE_libqrtr-glib=y
CONFIG_PACKAGE_libreadline=y
CONFIG_PACKAGE_libseccomp=y
CONFIG_PACKAGE_libsodium=y
CONFIG_PACKAGE_libsoxr=y
CONFIG_PACKAGE_libsqlite3=y
CONFIG_PACKAGE_libssh=y
CONFIG_PACKAGE_libssh2=y
CONFIG_PACKAGE_libstdcpp=y
CONFIG_PACKAGE_libtasn1=y
CONFIG_PACKAGE_libtirpc=y
CONFIG_PACKAGE_libubus-lua=y
CONFIG_PACKAGE_libuci-lua=y
CONFIG_PACKAGE_libudev-zero=y
CONFIG_PACKAGE_libudns=y
CONFIG_PACKAGE_libugpio=y
CONFIG_PACKAGE_libunistring=y
CONFIG_PACKAGE_libupnp=y
CONFIG_PACKAGE_liburing=y
CONFIG_PACKAGE_libusb-1.0=y
CONFIG_PACKAGE_libusbmuxd=y
CONFIG_PACKAGE_libusbmuxd-utils=y
CONFIG_PACKAGE_libustream-openssl=y
# CONFIG_PACKAGE_libustream-wolfssl is not set
CONFIG_PACKAGE_libuv=y
CONFIG_PACKAGE_libv4l=y
CONFIG_PACKAGE_libvorbis=y
CONFIG_PACKAGE_libwebsockets-full=y
CONFIG_PACKAGE_libwrap=y
CONFIG_PACKAGE_libxml2=y
CONFIG_PACKAGE_libyaml=y
CONFIG_PACKAGE_libzmq-nc=y
CONFIG_PACKAGE_libzstd=y
CONFIG_PACKAGE_lsblk=y
CONFIG_PACKAGE_lscpu=y
CONFIG_PACKAGE_lua=y
CONFIG_PACKAGE_luci=y
CONFIG_PACKAGE_luci-app-aria2=y
CONFIG_PACKAGE_luci-app-cifs-mount=y
CONFIG_PACKAGE_luci-app-commands=y
CONFIG_PACKAGE_luci-app-ddns=y
CONFIG_PACKAGE_luci-app-diskman=y
CONFIG_PACKAGE_luci-app-diskman_INCLUDE_btrfs_progs=y
CONFIG_PACKAGE_luci-app-diskman_INCLUDE_kmod_md_linear=y
CONFIG_PACKAGE_luci-app-diskman_INCLUDE_kmod_md_raid456=y
CONFIG_PACKAGE_luci-app-diskman_INCLUDE_lsblk=y
CONFIG_PACKAGE_luci-app-diskman_INCLUDE_mdadm=y
CONFIG_PACKAGE_luci-app-dockerman=y
CONFIG_PACKAGE_luci-app-fileassistant=y
CONFIG_PACKAGE_luci-app-firewall=y
CONFIG_PACKAGE_luci-app-hd-idle=y
CONFIG_PACKAGE_luci-app-minidlna=y
CONFIG_PACKAGE_luci-app-mjpg-streamer=y
CONFIG_PACKAGE_luci-app-mwan3=y
CONFIG_PACKAGE_luci-app-nlbwmon=y
CONFIG_PACKAGE_luci-app-opkg=y
CONFIG_PACKAGE_luci-app-samba4=y
CONFIG_PACKAGE_luci-app-shairplay=y
CONFIG_PACKAGE_luci-app-sqm=y
CONFIG_PACKAGE_luci-app-syncdial=y
CONFIG_PACKAGE_luci-app-tinyproxy=y
CONFIG_PACKAGE_luci-app-ttyd=y
CONFIG_PACKAGE_luci-app-udpxy=y
CONFIG_PACKAGE_luci-app-wifischedule=y
CONFIG_PACKAGE_luci-base=y
CONFIG_PACKAGE_luci-compat=y
CONFIG_PACKAGE_luci-i18n-aria2-ca=y
CONFIG_PACKAGE_luci-i18n-aria2-cs=y
CONFIG_PACKAGE_luci-i18n-aria2-de=y
CONFIG_PACKAGE_luci-i18n-aria2-el=y
CONFIG_PACKAGE_luci-i18n-aria2-en=y
CONFIG_PACKAGE_luci-i18n-aria2-es=y
CONFIG_PACKAGE_luci-i18n-aria2-fr=y
CONFIG_PACKAGE_luci-i18n-aria2-he=y
CONFIG_PACKAGE_luci-i18n-aria2-hu=y
CONFIG_PACKAGE_luci-i18n-aria2-it=y
CONFIG_PACKAGE_luci-i18n-aria2-ja=y
CONFIG_PACKAGE_luci-i18n-aria2-ko=y
CONFIG_PACKAGE_luci-i18n-aria2-ms=y
CONFIG_PACKAGE_luci-i18n-aria2-pl=y
CONFIG_PACKAGE_luci-i18n-aria2-pt=y
CONFIG_PACKAGE_luci-i18n-aria2-ro=y
CONFIG_PACKAGE_luci-i18n-aria2-ru=y
CONFIG_PACKAGE_luci-i18n-aria2-sk=y
CONFIG_PACKAGE_luci-i18n-aria2-sv=y
CONFIG_PACKAGE_luci-i18n-aria2-tr=y
CONFIG_PACKAGE_luci-i18n-aria2-uk=y
CONFIG_PACKAGE_luci-i18n-aria2-vi=y
CONFIG_PACKAGE_luci-i18n-aria2-zh-cn=y
CONFIG_PACKAGE_luci-i18n-aria2-zh-tw=y
CONFIG_PACKAGE_luci-i18n-base-ca=y
CONFIG_PACKAGE_luci-i18n-base-cs=y
CONFIG_PACKAGE_luci-i18n-base-de=y
CONFIG_PACKAGE_luci-i18n-base-el=y
CONFIG_PACKAGE_luci-i18n-base-en=y
CONFIG_PACKAGE_luci-i18n-base-es=y
CONFIG_PACKAGE_luci-i18n-base-fr=y
CONFIG_PACKAGE_luci-i18n-base-he=y
CONFIG_PACKAGE_luci-i18n-base-hu=y
CONFIG_PACKAGE_luci-i18n-base-it=y
CONFIG_PACKAGE_luci-i18n-base-ja=y
CONFIG_PACKAGE_luci-i18n-base-ko=y
CONFIG_PACKAGE_luci-i18n-base-ms=y
CONFIG_PACKAGE_luci-i18n-base-pl=y
CONFIG_PACKAGE_luci-i18n-base-pt=y
CONFIG_PACKAGE_luci-i18n-base-ro=y
CONFIG_PACKAGE_luci-i18n-base-ru=y
CONFIG_PACKAGE_luci-i18n-base-sk=y
CONFIG_PACKAGE_luci-i18n-base-sv=y
CONFIG_PACKAGE_luci-i18n-base-tr=y
CONFIG_PACKAGE_luci-i18n-base-uk=y
CONFIG_PACKAGE_luci-i18n-base-vi=y
CONFIG_PACKAGE_luci-i18n-base-zh-cn=y
CONFIG_PACKAGE_luci-i18n-base-zh-tw=y
CONFIG_PACKAGE_luci-i18n-commands-ca=y
CONFIG_PACKAGE_luci-i18n-commands-cs=y
CONFIG_PACKAGE_luci-i18n-commands-de=y
CONFIG_PACKAGE_luci-i18n-commands-el=y
CONFIG_PACKAGE_luci-i18n-commands-en=y
CONFIG_PACKAGE_luci-i18n-commands-es=y
CONFIG_PACKAGE_luci-i18n-commands-fr=y
CONFIG_PACKAGE_luci-i18n-commands-he=y
CONFIG_PACKAGE_luci-i18n-commands-hu=y
CONFIG_PACKAGE_luci-i18n-commands-it=y
CONFIG_PACKAGE_luci-i18n-commands-ja=y
CONFIG_PACKAGE_luci-i18n-commands-ko=y
CONFIG_PACKAGE_luci-i18n-commands-ms=y
CONFIG_PACKAGE_luci-i18n-commands-pl=y
CONFIG_PACKAGE_luci-i18n-commands-pt=y
CONFIG_PACKAGE_luci-i18n-commands-ro=y
CONFIG_PACKAGE_luci-i18n-commands-ru=y
CONFIG_PACKAGE_luci-i18n-commands-sk=y
CONFIG_PACKAGE_luci-i18n-commands-sv=y
CONFIG_PACKAGE_luci-i18n-commands-tr=y
CONFIG_PACKAGE_luci-i18n-commands-uk=y
CONFIG_PACKAGE_luci-i18n-commands-vi=y
CONFIG_PACKAGE_luci-i18n-commands-zh-cn=y
CONFIG_PACKAGE_luci-i18n-commands-zh-tw=y
CONFIG_PACKAGE_luci-i18n-ddns-ca=y
CONFIG_PACKAGE_luci-i18n-ddns-cs=y
CONFIG_PACKAGE_luci-i18n-ddns-de=y
CONFIG_PACKAGE_luci-i18n-ddns-el=y
CONFIG_PACKAGE_luci-i18n-ddns-en=y
CONFIG_PACKAGE_luci-i18n-ddns-es=y
CONFIG_PACKAGE_luci-i18n-ddns-fr=y
CONFIG_PACKAGE_luci-i18n-ddns-he=y
CONFIG_PACKAGE_luci-i18n-ddns-hu=y
CONFIG_PACKAGE_luci-i18n-ddns-it=y
CONFIG_PACKAGE_luci-i18n-ddns-ja=y
CONFIG_PACKAGE_luci-i18n-ddns-ko=y
CONFIG_PACKAGE_luci-i18n-ddns-ms=y
CONFIG_PACKAGE_luci-i18n-ddns-pl=y
CONFIG_PACKAGE_luci-i18n-ddns-pt=y
CONFIG_PACKAGE_luci-i18n-ddns-ro=y
CONFIG_PACKAGE_luci-i18n-ddns-ru=y
CONFIG_PACKAGE_luci-i18n-ddns-sk=y
CONFIG_PACKAGE_luci-i18n-ddns-sv=y
CONFIG_PACKAGE_luci-i18n-ddns-tr=y
CONFIG_PACKAGE_luci-i18n-ddns-uk=y
CONFIG_PACKAGE_luci-i18n-ddns-vi=y
CONFIG_PACKAGE_luci-i18n-ddns-zh-cn=y
CONFIG_PACKAGE_luci-i18n-ddns-zh-tw=y
CONFIG_PACKAGE_luci-i18n-dockerman-zh-cn=y
CONFIG_PACKAGE_luci-i18n-firewall-ca=y
CONFIG_PACKAGE_luci-i18n-firewall-cs=y
CONFIG_PACKAGE_luci-i18n-firewall-de=y
CONFIG_PACKAGE_luci-i18n-firewall-el=y
CONFIG_PACKAGE_luci-i18n-firewall-en=y
CONFIG_PACKAGE_luci-i18n-firewall-es=y
CONFIG_PACKAGE_luci-i18n-firewall-fr=y
CONFIG_PACKAGE_luci-i18n-firewall-he=y
CONFIG_PACKAGE_luci-i18n-firewall-hu=y
CONFIG_PACKAGE_luci-i18n-firewall-it=y
CONFIG_PACKAGE_luci-i18n-firewall-ja=y
CONFIG_PACKAGE_luci-i18n-firewall-ko=y
CONFIG_PACKAGE_luci-i18n-firewall-ms=y
CONFIG_PACKAGE_luci-i18n-firewall-pl=y
CONFIG_PACKAGE_luci-i18n-firewall-pt=y
CONFIG_PACKAGE_luci-i18n-firewall-ro=y
CONFIG_PACKAGE_luci-i18n-firewall-ru=y
CONFIG_PACKAGE_luci-i18n-firewall-sk=y
CONFIG_PACKAGE_luci-i18n-firewall-sv=y
CONFIG_PACKAGE_luci-i18n-firewall-tr=y
CONFIG_PACKAGE_luci-i18n-firewall-uk=y
CONFIG_PACKAGE_luci-i18n-firewall-vi=y
CONFIG_PACKAGE_luci-i18n-firewall-zh-cn=y
CONFIG_PACKAGE_luci-i18n-firewall-zh-tw=y
CONFIG_PACKAGE_luci-i18n-hd-idle-ca=y
CONFIG_PACKAGE_luci-i18n-hd-idle-cs=y
CONFIG_PACKAGE_luci-i18n-hd-idle-de=y
CONFIG_PACKAGE_luci-i18n-hd-idle-el=y
CONFIG_PACKAGE_luci-i18n-hd-idle-en=y
CONFIG_PACKAGE_luci-i18n-hd-idle-es=y
CONFIG_PACKAGE_luci-i18n-hd-idle-fr=y
CONFIG_PACKAGE_luci-i18n-hd-idle-he=y
CONFIG_PACKAGE_luci-i18n-hd-idle-hu=y
CONFIG_PACKAGE_luci-i18n-hd-idle-it=y
CONFIG_PACKAGE_luci-i18n-hd-idle-ja=y
CONFIG_PACKAGE_luci-i18n-hd-idle-ms=y
CONFIG_PACKAGE_luci-i18n-hd-idle-pl=y
CONFIG_PACKAGE_luci-i18n-hd-idle-pt=y
CONFIG_PACKAGE_luci-i18n-hd-idle-ro=y
CONFIG_PACKAGE_luci-i18n-hd-idle-ru=y
CONFIG_PACKAGE_luci-i18n-hd-idle-sk=y
CONFIG_PACKAGE_luci-i18n-hd-idle-sv=y
CONFIG_PACKAGE_luci-i18n-hd-idle-tr=y
CONFIG_PACKAGE_luci-i18n-hd-idle-uk=y
CONFIG_PACKAGE_luci-i18n-hd-idle-vi=y
CONFIG_PACKAGE_luci-i18n-hd-idle-zh-cn=y
CONFIG_PACKAGE_luci-i18n-hd-idle-zh-tw=y
CONFIG_PACKAGE_luci-i18n-minidlna-ca=y
CONFIG_PACKAGE_luci-i18n-minidlna-cs=y
CONFIG_PACKAGE_luci-i18n-minidlna-de=y
CONFIG_PACKAGE_luci-i18n-minidlna-el=y
CONFIG_PACKAGE_luci-i18n-minidlna-en=y
CONFIG_PACKAGE_luci-i18n-minidlna-es=y
CONFIG_PACKAGE_luci-i18n-minidlna-fr=y
CONFIG_PACKAGE_luci-i18n-minidlna-he=y
CONFIG_PACKAGE_luci-i18n-minidlna-hu=y
CONFIG_PACKAGE_luci-i18n-minidlna-it=y
CONFIG_PACKAGE_luci-i18n-minidlna-ja=y
CONFIG_PACKAGE_luci-i18n-minidlna-ko=y
CONFIG_PACKAGE_luci-i18n-minidlna-ms=y
CONFIG_PACKAGE_luci-i18n-minidlna-pl=y
CONFIG_PACKAGE_luci-i18n-minidlna-pt=y
CONFIG_PACKAGE_luci-i18n-minidlna-ro=y
CONFIG_PACKAGE_luci-i18n-minidlna-ru=y
CONFIG_PACKAGE_luci-i18n-minidlna-sk=y
CONFIG_PACKAGE_luci-i18n-minidlna-sv=y
CONFIG_PACKAGE_luci-i18n-minidlna-tr=y
CONFIG_PACKAGE_luci-i18n-minidlna-uk=y
CONFIG_PACKAGE_luci-i18n-minidlna-vi=y
CONFIG_PACKAGE_luci-i18n-minidlna-zh-cn=y
CONFIG_PACKAGE_luci-i18n-minidlna-zh-tw=y
CONFIG_PACKAGE_luci-i18n-mjpg-streamer-ca=y
CONFIG_PACKAGE_luci-i18n-mjpg-streamer-cs=y
CONFIG_PACKAGE_luci-i18n-mjpg-streamer-de=y
CONFIG_PACKAGE_luci-i18n-mjpg-streamer-el=y
CONFIG_PACKAGE_luci-i18n-mjpg-streamer-en=y
CONFIG_PACKAGE_luci-i18n-mjpg-streamer-es=y
CONFIG_PACKAGE_luci-i18n-mjpg-streamer-fr=y
CONFIG_PACKAGE_luci-i18n-mjpg-streamer-he=y
CONFIG_PACKAGE_luci-i18n-mjpg-streamer-hu=y
CONFIG_PACKAGE_luci-i18n-mjpg-streamer-it=y
CONFIG_PACKAGE_luci-i18n-mjpg-streamer-ja=y
CONFIG_PACKAGE_luci-i18n-mjpg-streamer-ko=y
CONFIG_PACKAGE_luci-i18n-mjpg-streamer-ms=y
CONFIG_PACKAGE_luci-i18n-mjpg-streamer-pl=y
CONFIG_PACKAGE_luci-i18n-mjpg-streamer-pt=y
CONFIG_PACKAGE_luci-i18n-mjpg-streamer-ro=y
CONFIG_PACKAGE_luci-i18n-mjpg-streamer-ru=y
CONFIG_PACKAGE_luci-i18n-mjpg-streamer-sk=y
CONFIG_PACKAGE_luci-i18n-mjpg-streamer-sv=y
CONFIG_PACKAGE_luci-i18n-mjpg-streamer-tr=y
CONFIG_PACKAGE_luci-i18n-mjpg-streamer-uk=y
CONFIG_PACKAGE_luci-i18n-mjpg-streamer-vi=y
CONFIG_PACKAGE_luci-i18n-mjpg-streamer-zh-cn=y
CONFIG_PACKAGE_luci-i18n-mjpg-streamer-zh-tw=y
CONFIG_PACKAGE_luci-i18n-mwan3-ca=y
CONFIG_PACKAGE_luci-i18n-mwan3-cs=y
CONFIG_PACKAGE_luci-i18n-mwan3-de=y
CONFIG_PACKAGE_luci-i18n-mwan3-el=y
CONFIG_PACKAGE_luci-i18n-mwan3-en=y
CONFIG_PACKAGE_luci-i18n-mwan3-es=y
CONFIG_PACKAGE_luci-i18n-mwan3-fr=y
CONFIG_PACKAGE_luci-i18n-mwan3-he=y
CONFIG_PACKAGE_luci-i18n-mwan3-hu=y
CONFIG_PACKAGE_luci-i18n-mwan3-it=y
CONFIG_PACKAGE_luci-i18n-mwan3-ja=y
CONFIG_PACKAGE_luci-i18n-mwan3-ko=y
CONFIG_PACKAGE_luci-i18n-mwan3-ms=y
CONFIG_PACKAGE_luci-i18n-mwan3-pl=y
CONFIG_PACKAGE_luci-i18n-mwan3-pt=y
CONFIG_PACKAGE_luci-i18n-mwan3-ro=y
CONFIG_PACKAGE_luci-i18n-mwan3-ru=y
CONFIG_PACKAGE_luci-i18n-mwan3-sk=y
CONFIG_PACKAGE_luci-i18n-mwan3-sv=y
CONFIG_PACKAGE_luci-i18n-mwan3-tr=y
CONFIG_PACKAGE_luci-i18n-mwan3-uk=y
CONFIG_PACKAGE_luci-i18n-mwan3-vi=y
CONFIG_PACKAGE_luci-i18n-mwan3-zh-cn=y
CONFIG_PACKAGE_luci-i18n-mwan3-zh-tw=y
CONFIG_PACKAGE_luci-i18n-nlbwmon-ca=y
CONFIG_PACKAGE_luci-i18n-nlbwmon-cs=y
CONFIG_PACKAGE_luci-i18n-nlbwmon-de=y
CONFIG_PACKAGE_luci-i18n-nlbwmon-el=y
CONFIG_PACKAGE_luci-i18n-nlbwmon-en=y
CONFIG_PACKAGE_luci-i18n-nlbwmon-es=y
CONFIG_PACKAGE_luci-i18n-nlbwmon-fr=y
CONFIG_PACKAGE_luci-i18n-nlbwmon-he=y
CONFIG_PACKAGE_luci-i18n-nlbwmon-hu=y
CONFIG_PACKAGE_luci-i18n-nlbwmon-it=y
CONFIG_PACKAGE_luci-i18n-nlbwmon-ja=y
CONFIG_PACKAGE_luci-i18n-nlbwmon-ko=y
CONFIG_PACKAGE_luci-i18n-nlbwmon-ms=y
CONFIG_PACKAGE_luci-i18n-nlbwmon-pl=y
CONFIG_PACKAGE_luci-i18n-nlbwmon-pt=y
CONFIG_PACKAGE_luci-i18n-nlbwmon-ro=y
CONFIG_PACKAGE_luci-i18n-nlbwmon-ru=y
CONFIG_PACKAGE_luci-i18n-nlbwmon-sk=y
CONFIG_PACKAGE_luci-i18n-nlbwmon-sv=y
CONFIG_PACKAGE_luci-i18n-nlbwmon-tr=y
CONFIG_PACKAGE_luci-i18n-nlbwmon-uk=y
CONFIG_PACKAGE_luci-i18n-nlbwmon-vi=y
CONFIG_PACKAGE_luci-i18n-nlbwmon-zh-cn=y
CONFIG_PACKAGE_luci-i18n-nlbwmon-zh-tw=y
CONFIG_PACKAGE_luci-i18n-opkg-ca=y
CONFIG_PACKAGE_luci-i18n-opkg-cs=y
CONFIG_PACKAGE_luci-i18n-opkg-de=y
CONFIG_PACKAGE_luci-i18n-opkg-el=y
CONFIG_PACKAGE_luci-i18n-opkg-en=y
CONFIG_PACKAGE_luci-i18n-opkg-es=y
CONFIG_PACKAGE_luci-i18n-opkg-fr=y
CONFIG_PACKAGE_luci-i18n-opkg-he=y
CONFIG_PACKAGE_luci-i18n-opkg-hu=y
CONFIG_PACKAGE_luci-i18n-opkg-it=y
CONFIG_PACKAGE_luci-i18n-opkg-ja=y
CONFIG_PACKAGE_luci-i18n-opkg-ko=y
CONFIG_PACKAGE_luci-i18n-opkg-ms=y
CONFIG_PACKAGE_luci-i18n-opkg-pl=y
CONFIG_PACKAGE_luci-i18n-opkg-pt=y
CONFIG_PACKAGE_luci-i18n-opkg-ro=y
CONFIG_PACKAGE_luci-i18n-opkg-ru=y
CONFIG_PACKAGE_luci-i18n-opkg-sk=y
CONFIG_PACKAGE_luci-i18n-opkg-sv=y
CONFIG_PACKAGE_luci-i18n-opkg-tr=y
CONFIG_PACKAGE_luci-i18n-opkg-uk=y
CONFIG_PACKAGE_luci-i18n-opkg-vi=y
CONFIG_PACKAGE_luci-i18n-opkg-zh-cn=y
CONFIG_PACKAGE_luci-i18n-opkg-zh-tw=y
CONFIG_PACKAGE_luci-i18n-samba4-ca=y
CONFIG_PACKAGE_luci-i18n-samba4-cs=y
CONFIG_PACKAGE_luci-i18n-samba4-de=y
CONFIG_PACKAGE_luci-i18n-samba4-el=y
CONFIG_PACKAGE_luci-i18n-samba4-en=y
CONFIG_PACKAGE_luci-i18n-samba4-es=y
CONFIG_PACKAGE_luci-i18n-samba4-fr=y
CONFIG_PACKAGE_luci-i18n-samba4-he=y
CONFIG_PACKAGE_luci-i18n-samba4-hu=y
CONFIG_PACKAGE_luci-i18n-samba4-it=y
CONFIG_PACKAGE_luci-i18n-samba4-ja=y
CONFIG_PACKAGE_luci-i18n-samba4-ko=y
CONFIG_PACKAGE_luci-i18n-samba4-ms=y
CONFIG_PACKAGE_luci-i18n-samba4-pl=y
CONFIG_PACKAGE_luci-i18n-samba4-pt=y
CONFIG_PACKAGE_luci-i18n-samba4-ro=y
CONFIG_PACKAGE_luci-i18n-samba4-ru=y
CONFIG_PACKAGE_luci-i18n-samba4-sk=y
CONFIG_PACKAGE_luci-i18n-samba4-sv=y
CONFIG_PACKAGE_luci-i18n-samba4-tr=y
CONFIG_PACKAGE_luci-i18n-samba4-uk=y
CONFIG_PACKAGE_luci-i18n-samba4-vi=y
CONFIG_PACKAGE_luci-i18n-samba4-zh-cn=y
CONFIG_PACKAGE_luci-i18n-samba4-zh-tw=y
CONFIG_PACKAGE_luci-i18n-shairplay-ca=y
CONFIG_PACKAGE_luci-i18n-shairplay-cs=y
CONFIG_PACKAGE_luci-i18n-shairplay-de=y
CONFIG_PACKAGE_luci-i18n-shairplay-el=y
CONFIG_PACKAGE_luci-i18n-shairplay-en=y
CONFIG_PACKAGE_luci-i18n-shairplay-es=y
CONFIG_PACKAGE_luci-i18n-shairplay-fr=y
CONFIG_PACKAGE_luci-i18n-shairplay-he=y
CONFIG_PACKAGE_luci-i18n-shairplay-hu=y
CONFIG_PACKAGE_luci-i18n-shairplay-it=y
CONFIG_PACKAGE_luci-i18n-shairplay-ja=y
CONFIG_PACKAGE_luci-i18n-shairplay-ko=y
CONFIG_PACKAGE_luci-i18n-shairplay-ms=y
CONFIG_PACKAGE_luci-i18n-shairplay-pl=y
CONFIG_PACKAGE_luci-i18n-shairplay-pt=y
CONFIG_PACKAGE_luci-i18n-shairplay-ro=y
CONFIG_PACKAGE_luci-i18n-shairplay-ru=y
CONFIG_PACKAGE_luci-i18n-shairplay-sk=y
CONFIG_PACKAGE_luci-i18n-shairplay-sv=y
CONFIG_PACKAGE_luci-i18n-shairplay-tr=y
CONFIG_PACKAGE_luci-i18n-shairplay-uk=y
CONFIG_PACKAGE_luci-i18n-shairplay-vi=y
CONFIG_PACKAGE_luci-i18n-shairplay-zh-cn=y
CONFIG_PACKAGE_luci-i18n-shairplay-zh-tw=y
CONFIG_PACKAGE_luci-i18n-sqm-ca=y
CONFIG_PACKAGE_luci-i18n-sqm-cs=y
CONFIG_PACKAGE_luci-i18n-sqm-de=y
CONFIG_PACKAGE_luci-i18n-sqm-el=y
CONFIG_PACKAGE_luci-i18n-sqm-en=y
CONFIG_PACKAGE_luci-i18n-sqm-es=y
CONFIG_PACKAGE_luci-i18n-sqm-fr=y
CONFIG_PACKAGE_luci-i18n-sqm-he=y
CONFIG_PACKAGE_luci-i18n-sqm-hu=y
CONFIG_PACKAGE_luci-i18n-sqm-it=y
CONFIG_PACKAGE_luci-i18n-sqm-ja=y
CONFIG_PACKAGE_luci-i18n-sqm-ko=y
CONFIG_PACKAGE_luci-i18n-sqm-ms=y
CONFIG_PACKAGE_luci-i18n-sqm-pl=y
CONFIG_PACKAGE_luci-i18n-sqm-pt=y
CONFIG_PACKAGE_luci-i18n-sqm-ro=y
CONFIG_PACKAGE_luci-i18n-sqm-ru=y
CONFIG_PACKAGE_luci-i18n-sqm-sk=y
CONFIG_PACKAGE_luci-i18n-sqm-sv=y
CONFIG_PACKAGE_luci-i18n-sqm-tr=y
CONFIG_PACKAGE_luci-i18n-sqm-uk=y
CONFIG_PACKAGE_luci-i18n-sqm-vi=y
CONFIG_PACKAGE_luci-i18n-sqm-zh-cn=y
CONFIG_PACKAGE_luci-i18n-sqm-zh-tw=y
CONFIG_PACKAGE_luci-i18n-tinyproxy-ca=y
CONFIG_PACKAGE_luci-i18n-tinyproxy-cs=y
CONFIG_PACKAGE_luci-i18n-tinyproxy-de=y
CONFIG_PACKAGE_luci-i18n-tinyproxy-el=y
CONFIG_PACKAGE_luci-i18n-tinyproxy-en=y
CONFIG_PACKAGE_luci-i18n-tinyproxy-es=y
CONFIG_PACKAGE_luci-i18n-tinyproxy-fr=y
CONFIG_PACKAGE_luci-i18n-tinyproxy-he=y
CONFIG_PACKAGE_luci-i18n-tinyproxy-hu=y
CONFIG_PACKAGE_luci-i18n-tinyproxy-it=y
CONFIG_PACKAGE_luci-i18n-tinyproxy-ja=y
CONFIG_PACKAGE_luci-i18n-tinyproxy-ko=y
CONFIG_PACKAGE_luci-i18n-tinyproxy-ms=y
CONFIG_PACKAGE_luci-i18n-tinyproxy-pl=y
CONFIG_PACKAGE_luci-i18n-tinyproxy-pt=y
CONFIG_PACKAGE_luci-i18n-tinyproxy-ro=y
CONFIG_PACKAGE_luci-i18n-tinyproxy-ru=y
CONFIG_PACKAGE_luci-i18n-tinyproxy-sk=y
CONFIG_PACKAGE_luci-i18n-tinyproxy-sv=y
CONFIG_PACKAGE_luci-i18n-tinyproxy-tr=y
CONFIG_PACKAGE_luci-i18n-tinyproxy-uk=y
CONFIG_PACKAGE_luci-i18n-tinyproxy-vi=y
CONFIG_PACKAGE_luci-i18n-tinyproxy-zh-cn=y
CONFIG_PACKAGE_luci-i18n-tinyproxy-zh-tw=y
CONFIG_PACKAGE_luci-i18n-ttyd-ca=y
CONFIG_PACKAGE_luci-i18n-ttyd-cs=y
CONFIG_PACKAGE_luci-i18n-ttyd-de=y
CONFIG_PACKAGE_luci-i18n-ttyd-el=y
CONFIG_PACKAGE_luci-i18n-ttyd-en=y
CONFIG_PACKAGE_luci-i18n-ttyd-es=y
CONFIG_PACKAGE_luci-i18n-ttyd-fr=y
CONFIG_PACKAGE_luci-i18n-ttyd-he=y
CONFIG_PACKAGE_luci-i18n-ttyd-hu=y
CONFIG_PACKAGE_luci-i18n-ttyd-it=y
CONFIG_PACKAGE_luci-i18n-ttyd-ja=y
CONFIG_PACKAGE_luci-i18n-ttyd-ko=y
CONFIG_PACKAGE_luci-i18n-ttyd-ms=y
CONFIG_PACKAGE_luci-i18n-ttyd-pl=y
CONFIG_PACKAGE_luci-i18n-ttyd-pt=y
CONFIG_PACKAGE_luci-i18n-ttyd-ro=y
CONFIG_PACKAGE_luci-i18n-ttyd-ru=y
CONFIG_PACKAGE_luci-i18n-ttyd-sk=y
CONFIG_PACKAGE_luci-i18n-ttyd-sv=y
CONFIG_PACKAGE_luci-i18n-ttyd-tr=y
CONFIG_PACKAGE_luci-i18n-ttyd-uk=y
CONFIG_PACKAGE_luci-i18n-ttyd-vi=y
CONFIG_PACKAGE_luci-i18n-ttyd-zh-cn=y
CONFIG_PACKAGE_luci-i18n-ttyd-zh-tw=y
CONFIG_PACKAGE_luci-i18n-udpxy-ca=y
CONFIG_PACKAGE_luci-i18n-udpxy-cs=y
CONFIG_PACKAGE_luci-i18n-udpxy-de=y
CONFIG_PACKAGE_luci-i18n-udpxy-el=y
CONFIG_PACKAGE_luci-i18n-udpxy-en=y
CONFIG_PACKAGE_luci-i18n-udpxy-es=y
CONFIG_PACKAGE_luci-i18n-udpxy-fr=y
CONFIG_PACKAGE_luci-i18n-udpxy-he=y
CONFIG_PACKAGE_luci-i18n-udpxy-hu=y
CONFIG_PACKAGE_luci-i18n-udpxy-it=y
CONFIG_PACKAGE_luci-i18n-udpxy-ja=y
CONFIG_PACKAGE_luci-i18n-udpxy-ko=y
CONFIG_PACKAGE_luci-i18n-udpxy-ms=y
CONFIG_PACKAGE_luci-i18n-udpxy-pl=y
CONFIG_PACKAGE_luci-i18n-udpxy-pt=y
CONFIG_PACKAGE_luci-i18n-udpxy-ro=y
CONFIG_PACKAGE_luci-i18n-udpxy-ru=y
CONFIG_PACKAGE_luci-i18n-udpxy-sk=y
CONFIG_PACKAGE_luci-i18n-udpxy-sv=y
CONFIG_PACKAGE_luci-i18n-udpxy-tr=y
CONFIG_PACKAGE_luci-i18n-udpxy-uk=y
CONFIG_PACKAGE_luci-i18n-udpxy-vi=y
CONFIG_PACKAGE_luci-i18n-udpxy-zh-cn=y
CONFIG_PACKAGE_luci-i18n-udpxy-zh-tw=y
CONFIG_PACKAGE_luci-i18n-wifischedule-ca=y
CONFIG_PACKAGE_luci-i18n-wifischedule-cs=y
CONFIG_PACKAGE_luci-i18n-wifischedule-de=y
CONFIG_PACKAGE_luci-i18n-wifischedule-el=y
CONFIG_PACKAGE_luci-i18n-wifischedule-en=y
CONFIG_PACKAGE_luci-i18n-wifischedule-es=y
CONFIG_PACKAGE_luci-i18n-wifischedule-fr=y
CONFIG_PACKAGE_luci-i18n-wifischedule-he=y
CONFIG_PACKAGE_luci-i18n-wifischedule-hu=y
CONFIG_PACKAGE_luci-i18n-wifischedule-it=y
CONFIG_PACKAGE_luci-i18n-wifischedule-ja=y
CONFIG_PACKAGE_luci-i18n-wifischedule-ko=y
CONFIG_PACKAGE_luci-i18n-wifischedule-ms=y
CONFIG_PACKAGE_luci-i18n-wifischedule-pl=y
CONFIG_PACKAGE_luci-i18n-wifischedule-pt=y
CONFIG_PACKAGE_luci-i18n-wifischedule-ro=y
CONFIG_PACKAGE_luci-i18n-wifischedule-ru=y
CONFIG_PACKAGE_luci-i18n-wifischedule-sk=y
CONFIG_PACKAGE_luci-i18n-wifischedule-sv=y
CONFIG_PACKAGE_luci-i18n-wifischedule-tr=y
CONFIG_PACKAGE_luci-i18n-wifischedule-uk=y
CONFIG_PACKAGE_luci-i18n-wifischedule-vi=y
CONFIG_PACKAGE_luci-i18n-wifischedule-zh-cn=y
CONFIG_PACKAGE_luci-i18n-wifischedule-zh-tw=y
CONFIG_PACKAGE_luci-lib-base=y
CONFIG_PACKAGE_luci-lib-docker=y
CONFIG_PACKAGE_luci-lib-ip=y
CONFIG_PACKAGE_luci-lib-ipkg=y
CONFIG_PACKAGE_luci-lib-jsonc=y
CONFIG_PACKAGE_luci-lib-nixio=y
CONFIG_PACKAGE_luci-mod-admin-full=y
CONFIG_PACKAGE_luci-mod-network=y
CONFIG_PACKAGE_luci-mod-status=y
CONFIG_PACKAGE_luci-mod-system=y
CONFIG_PACKAGE_luci-proto-3g=y
CONFIG_PACKAGE_luci-proto-bonding=y
CONFIG_PACKAGE_luci-proto-ipv6=y
CONFIG_PACKAGE_luci-proto-ncm=y
CONFIG_PACKAGE_luci-proto-openconnect=y
CONFIG_PACKAGE_luci-proto-ppp=y
CONFIG_PACKAGE_luci-proto-qmi=y
CONFIG_PACKAGE_luci-proto-relay=y
CONFIG_PACKAGE_luci-proto-wireguard=y
CONFIG_PACKAGE_luci-theme-argon=y
CONFIG_PACKAGE_luci-theme-bootstrap=y
CONFIG_PACKAGE_luci-theme-material=y
CONFIG_PACKAGE_mdadm=y
CONFIG_PACKAGE_mentohust=y
CONFIG_PACKAGE_minidlna=y
CONFIG_PACKAGE_mjpg-streamer=y
CONFIG_PACKAGE_mjpg-streamer-input-file=y
CONFIG_PACKAGE_mjpg-streamer-input-http=y
CONFIG_PACKAGE_mjpg-streamer-input-uvc=y
CONFIG_PACKAGE_mjpg-streamer-output-file=y
CONFIG_PACKAGE_mjpg-streamer-output-http=y
CONFIG_PACKAGE_mjpg-streamer-output-rtsp=y
CONFIG_PACKAGE_mjpg-streamer-output-zmq=y
CONFIG_PACKAGE_mjpg-streamer-www-simple=y
CONFIG_PACKAGE_modemmanager=y
CONFIG_PACKAGE_mount-utils=y
CONFIG_PACKAGE_msgpack-c=y
CONFIG_PACKAGE_mt7601u-firmware=y
CONFIG_PACKAGE_mwan3=y
CONFIG_PACKAGE_mxml=y
CONFIG_PACKAGE_nano=y
CONFIG_PACKAGE_nfs-kernel-server=y
CONFIG_PACKAGE_nfs-kernel-server-utils=y
CONFIG_PACKAGE_nfs-utils=y
CONFIG_PACKAGE_nfs-utils-libs=y
CONFIG_PACKAGE_nft-qos=y
CONFIG_PACKAGE_nftables-nojson=y
CONFIG_PACKAGE_nlbwmon=y
CONFIG_PACKAGE_node=y
CONFIG_PACKAGE_node-bcrypt=y
CONFIG_PACKAGE_node-bufferutil=y
CONFIG_PACKAGE_node-firmata=y
CONFIG_PACKAGE_node-hap-nodejs=y
CONFIG_PACKAGE_node-johnny-five=y
CONFIG_PACKAGE_node-mdns=y
CONFIG_PACKAGE_node-modbus-serial=y
CONFIG_PACKAGE_node-mqtt=y
CONFIG_PACKAGE_node-npm=y
CONFIG_PACKAGE_node-red=y
CONFIG_PACKAGE_node-red-contrib-gpio=y
CONFIG_PACKAGE_node-red-contrib-homekit-bridged=y
CONFIG_PACKAGE_node-red-contrib-modbus=y
CONFIG_PACKAGE_node-red-dashboard=y
CONFIG_PACKAGE_node-red-node-arduino=y
CONFIG_PACKAGE_node-red-node-discovery=y
CONFIG_PACKAGE_node-red-node-serialport=y
CONFIG_PACKAGE_node-red-node-sqlite=y
CONFIG_PACKAGE_node-serialport=y
CONFIG_PACKAGE_node-serialport-bindings=y
CONFIG_PACKAGE_node-serialport-bindings-cpp=y
CONFIG_PACKAGE_node-serialport-list=y
CONFIG_PACKAGE_node-sqlite3=y
CONFIG_PACKAGE_node-utf-8-validate=y
CONFIG_PACKAGE_node-ws=y
CONFIG_PACKAGE_ntfs3-mount=y
CONFIG_PACKAGE_openconnect=y
CONFIG_PACKAGE_openssh-sftp-client=y
CONFIG_PACKAGE_openssh-sftp-server=y
CONFIG_PACKAGE_openssl-util=y
CONFIG_PACKAGE_openvpn-easy-rsa=y
CONFIG_PACKAGE_openvpn-openssl=y
CONFIG_PACKAGE_p54-usb-firmware=y
CONFIG_PACKAGE_p910nd=y
CONFIG_PACKAGE_parted=y
CONFIG_PACKAGE_ppp-mod-pppol2tp=y
CONFIG_PACKAGE_ppp-mod-pptp=y
CONFIG_PACKAGE_prism54-firmware=y
CONFIG_PACKAGE_proto-bonding=y
CONFIG_PACKAGE_ps3netsrv=y
CONFIG_PACKAGE_python3=y
CONFIG_PACKAGE_python3-asyncio=y
CONFIG_PACKAGE_python3-attrs=y
CONFIG_PACKAGE_python3-base=y
CONFIG_PACKAGE_python3-bcrypt=y
CONFIG_PACKAGE_python3-cached-property=y
CONFIG_PACKAGE_python3-certifi=y
CONFIG_PACKAGE_python3-cffi=y
CONFIG_PACKAGE_python3-cgi=y
CONFIG_PACKAGE_python3-cgitb=y
CONFIG_PACKAGE_python3-chardet=y
CONFIG_PACKAGE_python3-codecs=y
CONFIG_PACKAGE_python3-cryptography=y
CONFIG_PACKAGE_python3-ctypes=y
CONFIG_PACKAGE_python3-dbm=y
CONFIG_PACKAGE_python3-decimal=y
CONFIG_PACKAGE_python3-distro=y
CONFIG_PACKAGE_python3-distutils=y
CONFIG_PACKAGE_python3-docker=y
CONFIG_PACKAGE_python3-dockerpty=y
CONFIG_PACKAGE_python3-docopt=y
CONFIG_PACKAGE_python3-dotenv=y
CONFIG_PACKAGE_python3-email=y
CONFIG_PACKAGE_python3-gdbm=y
CONFIG_PACKAGE_python3-idna=y
CONFIG_PACKAGE_python3-jsonschema=y
CONFIG_PACKAGE_python3-light=y
CONFIG_PACKAGE_python3-logging=y
CONFIG_PACKAGE_python3-lzma=y
CONFIG_PACKAGE_python3-multiprocessing=y
CONFIG_PACKAGE_python3-ncurses=y
CONFIG_PACKAGE_python3-openssl=y
CONFIG_PACKAGE_python3-paramiko=y
CONFIG_PACKAGE_python3-pkg-resources=y
CONFIG_PACKAGE_python3-ply=y
CONFIG_PACKAGE_python3-pycparser=y
CONFIG_PACKAGE_python3-pydoc=y
CONFIG_PACKAGE_python3-pynacl=y
CONFIG_PACKAGE_python3-pyrsistent=y
CONFIG_PACKAGE_python3-readline=y
CONFIG_PACKAGE_python3-requests=y
CONFIG_PACKAGE_python3-setuptools=y
CONFIG_PACKAGE_python3-six=y
CONFIG_PACKAGE_python3-sqlite3=y
CONFIG_PACKAGE_python3-texttable=y
CONFIG_PACKAGE_python3-unittest=y
CONFIG_PACKAGE_python3-urllib=y
CONFIG_PACKAGE_python3-urllib3=y
CONFIG_PACKAGE_python3-websocket-client=y
CONFIG_PACKAGE_python3-xml=y
CONFIG_PACKAGE_python3-yaml=y
CONFIG_PACKAGE_rclone=y
CONFIG_PACKAGE_rclone-config=y
CONFIG_PACKAGE_rclone-ng=y
CONFIG_PACKAGE_rclone-webui-react=y
CONFIG_PACKAGE_relayd=y
CONFIG_PACKAGE_resize2fs=y
CONFIG_PACKAGE_resolveip=y
CONFIG_PACKAGE_rpcbind=y
CONFIG_PACKAGE_rpcd=y
CONFIG_PACKAGE_rpcd-mod-file=y
CONFIG_PACKAGE_rpcd-mod-iwinfo=y
CONFIG_PACKAGE_rpcd-mod-luci=y
CONFIG_PACKAGE_rpcd-mod-rrdns=y
CONFIG_PACKAGE_rs9113-firmware=y
CONFIG_PACKAGE_rsync=y
CONFIG_PACKAGE_rsyncd=y
CONFIG_PACKAGE_rt2800-usb-firmware=y
CONFIG_PACKAGE_rt73-usb-firmware=y
CONFIG_PACKAGE_rtl8188eu-firmware=y
CONFIG_PACKAGE_rtl8192cu-firmware=y
CONFIG_PACKAGE_rtl8192eu-firmware=y
CONFIG_PACKAGE_rtl8192su-firmware=y
CONFIG_PACKAGE_rtl8723au-firmware=y
CONFIG_PACKAGE_rtl8723bu-firmware=y
CONFIG_PACKAGE_runc=y
CONFIG_PACKAGE_samba4-libs=y
CONFIG_PACKAGE_samba4-server=y
CONFIG_PACKAGE_screen=y
CONFIG_PACKAGE_shairplay=y
CONFIG_PACKAGE_shairport-sync-openssl=y
CONFIG_PACKAGE_smartdns=y
CONFIG_PACKAGE_smartmontools=y
CONFIG_PACKAGE_snmpd=y
CONFIG_PACKAGE_softethervpn5-bridge=y
CONFIG_PACKAGE_softethervpn5-client=y
CONFIG_PACKAGE_softethervpn5-libs=y
CONFIG_PACKAGE_softethervpn5-server=y
CONFIG_PACKAGE_sqlite3-cli=y
CONFIG_PACKAGE_sqm-scripts=y
CONFIG_PACKAGE_tc-mod-iptables=y
CONFIG_PACKAGE_tc-tiny=y
CONFIG_PACKAGE_terminfo=y
CONFIG_PACKAGE_tini=y
CONFIG_PACKAGE_tinyproxy=y
CONFIG_PACKAGE_tmate=y
CONFIG_PACKAGE_tmux=y
CONFIG_PACKAGE_transmission-daemon=y
CONFIG_PACKAGE_ttyd=y
CONFIG_PACKAGE_uclibcxx=y
CONFIG_PACKAGE_udpxy=y
CONFIG_PACKAGE_uhttpd=y
CONFIG_PACKAGE_uhttpd-mod-ubus=y
CONFIG_PACKAGE_umbim=y
CONFIG_PACKAGE_unzip=y
CONFIG_PACKAGE_uqmi=y
CONFIG_PACKAGE_usb-modeswitch=y
CONFIG_PACKAGE_usbids=y
CONFIG_PACKAGE_usbmuxd=y
CONFIG_PACKAGE_usbutils=y
CONFIG_PACKAGE_vpnc-scripts=y
CONFIG_PACKAGE_watchcat=y
CONFIG_PACKAGE_webui-aria2=y
CONFIG_PACKAGE_whereis=y
CONFIG_PACKAGE_wifischedule=y
CONFIG_PACKAGE_wireguard-tools=y
CONFIG_PACKAGE_wsdd2=y
CONFIG_PACKAGE_wwan=y
CONFIG_PACKAGE_xl2tpd=y
CONFIG_PACKAGE_xray-core=y
CONFIG_PACKAGE_zerotier=y
CONFIG_PACKAGE_zlib=y
CONFIG_PARTED_READLINE=y
CONFIG_RPCBIND_LIBWRAP=y
CONFIG_RPCBIND_RMTCALLS=y
CONFIG_SAMBA4_SERVER_AVAHI=y
CONFIG_SAMBA4_SERVER_NETBIOS=y
CONFIG_SAMBA4_SERVER_VFS=y
CONFIG_SAMBA4_SERVER_WSDD2=y
CONFIG_SQLITE3_DYNAMIC_EXTENSIONS=y
CONFIG_SQLITE3_FTS3=y
CONFIG_SQLITE3_FTS4=y
CONFIG_SQLITE3_FTS5=y
CONFIG_SQLITE3_JSON1=y
CONFIG_SQLITE3_LIBEDIT=y
CONFIG_SQLITE3_RTREE=y
CONFIG_TARGET_EXT4_JOURNAL=y
CONFIG_TARGET_KERNEL_PARTSIZE=256
CONFIG_TARGET_ROOTFS_PARTSIZE=2048
# CONFIG_WOLFSSL_HAS_ECC25519 is not set
CONFIG_ZSTD_OPTIMIZE_O3=y
CONFIG_boost-compile-visibility-hidden=y
CONFIG_boost-runtime-shared=y
CONFIG_boost-static-and-shared-libs=y
CONFIG_boost-variant-release=y
# CONFIG_LIBCURL_NGHTTP2 is not set
```
